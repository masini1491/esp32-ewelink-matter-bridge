## platform/esp32c3_probe/sdkconfig.defaults
```kconfig
CONFIG_IDF_TARGET="esp32c3"
CONFIG_ESPTOOLPY_FLASHSIZE_4MB=y
CONFIG_PARTITION_TABLE_CUSTOM=y
CONFIG_PARTITION_TABLE_FILENAME="partitions.csv"
CONFIG_PARTITION_TABLE_OFFSET=0xC000
CONFIG_BT_ENABLED=y
CONFIG_BT_NIMBLE_ENABLED=y
CONFIG_BT_NIMBLE_ENABLE_CONN_REATTEMPT=n
CONFIG_LWIP_IPV6_AUTOCONFIG=y
CONFIG_LWIP_HOOK_IP6_ROUTE_DEFAULT=y
CONFIG_LWIP_HOOK_ND6_GET_GW_DEFAULT=y
CONFIG_ESP_WIFI_SOFTAP_SUPPORT=n
CONFIG_MBEDTLS_HKDF_C=y
CONFIG_LWIP_IPV6_NUM_ADDRESSES=6
CONFIG_SUPPORT_GROUPCAST_CLUSTER=n
CONFIG_ESP_MATTER_MAX_DYNAMIC_ENDPOINT_COUNT=5
CONFIG_ESP_MATTER_AGGREGATOR_ENDPOINT_COUNT=1
CONFIG_ESP_MATTER_BRIDGE_INFO_PART_NAME="nvs"
# Compile-probe-only Matter OTA metadata. These are not product release values.
CONFIG_APP_PROJECT_VER_FROM_CONFIG=y
CONFIG_APP_PROJECT_VER="0.0.1"
CONFIG_DEVICE_SOFTWARE_VERSION_NUMBER=1
CONFIG_CHIP_OTA_IMAGE_BUILD=y
```
